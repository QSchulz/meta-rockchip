## conf/machine/firefly-emmc.conf
```bitbake
# Copyright (C) 2015 Trevor Woerner
# Released under the MIT license (see COPYING.MIT for the terms)

#@TYPE: Machine
#@NAME: Firefly RK3288
#@DESCRIPTION: Machine configuration to create an eMMC update image for the Firefly
#http://www.t-firefly.com/en/

require conf/machine/include/tune-cortexa15.inc
DEFAULTTUNE="cortexa15-neon"

SERIAL_CONSOLES = "115200;ttyS2"

PREFERRED_PROVIDER_virtual/kernel = "firefly-rk3288-kernel"
KERNEL_DEVICETREE = "rk3288-firefly.dtb"
KERNEL_IMAGETYPE = "zImage"

IMAGE_CLASSES += "firefly-emmc-update-img"
IMAGE_FSTYPES += "ext4 firefly-emmc-update-img"
CORE_IMAGE_EXTRA_INSTALL += "kernel-modules kernel-base kernel-module-gspca-main kernel-module-mali-kbase"
```

## conf/machine/include/rk3588.inc
```bitbake
# Copyright (C) 2023 Theobroma Systems Design und Consulting GmbH
# Released under the MIT license (see COPYING.MIT for the terms)

SOC_FAMILY = "rk3588"

MACHINEOVERRIDES =. "rk3588s:"

require conf/machine/include/rk3588s.inc
```

## conf/machine/include/rk3588s.inc
```bitbake
# Copyright (C) 2023 Theobroma Systems Design und Consulting GmbH
# Released under the MIT license (see COPYING.MIT for the terms)

SOC_FAMILY = "rk3588s"

DEFAULTTUNE ?= "cortexa76-cortexa55-crypto"

require conf/machine/include/soc-family.inc
require conf/machine/include/arm/armv8-2a/tune-cortexa76-cortexa55.inc
require conf/machine/include/rockchip-defaults.inc
require conf/machine/include/rockchip-wic.inc

KBUILD_DEFCONFIG ?= "defconfig"
KERNEL_FEATURES:append:rk3588s = " bsp/rockchip/remove-non-rockchip-arch-arm64.scc"
KERNEL_CLASSES = "kernel-fitimage"
KERNEL_IMAGETYPE = "fitImage"

PREFERRED_PROVIDER_trusted-firmware-a = "rockchip-bin"
PREFERRED_PROVIDER_optee-os = "rockchip-bin"

TFA_PLATFORM = "rk3588"
TFA_BUILD_TARGET = "bl31"

UBOOT_SUFFIX ?= "itb"
UBOOT_ENTRYPOINT ?= "0x06000000"
```

## conf/machine/include/rockchip-defaults.inc
```bitbake
# meta-rockchip default settings

# kernel
RK_KERNEL_CONFIG_TYPE ?= "inkernel"
python __anonymous() {
    configtype = d.getVar("RK_KERNEL_CONFIG_TYPE")
    machine = d.getVar("MACHINE")
    kbuild_defconfig = ""
    inlayer_64_support = ['rock-pi-4b']
    noinlayer_64_support = ['rock-pi-4a', 'rock-pi-4c', 'nanopi-m4', 'nanopi-m4-2gb', 'rock-pi-e']
    inlayer_32_support = []
    noinlayer_32_support = ['tinker-board', 'tinker-board-s', 'vyasa-rk3288', 'firefly-rk3288',
        'radxarock', 'rock2-square', 'marsboard-rk3066']

    if configtype != "inkernel" and configtype != "inlayer":
        raise Exception("RK_KERNEL_CONFIG_TYPE must be set to one of 'inlayer' or 'inkernel'")
    if machine == "":
        raise Exception("please set the MACHINE")

    # aarch64 machines
    if machine in inlayer_64_support:
        if configtype == "inlayer":
            kbuild_defconfig = ""
        else:
            kbuild_defconfig = "defconfig"
    elif machine in noinlayer_64_support:
        if configtype == "inlayer":
            raise Exception("%s doesn't support in-layer kernel config" % machine)
        kbuild_defconfig = "defconfig"

    # arm machines
    elif machine in inlayer_32_support:
        if configtype == "inlayer":
            kbuild_defconfig = ""
        else:
            kbuild_defconfig = "multi_v7_defconfig"
    elif machine in noinlayer_32_support:
        if configtype == "inlayer":
            raise Exception("%s doesn't support in-layer kernel config" % machine)
        kbuild_defconfig = "multi_v7_defconfig"

    #otherwise
    else:
        raise Exception("unsupported machine: %s" % machine)

    d.setVar("KBUILD_DEFCONFIG", kbuild_defconfig)
}
PREFERRED_PROVIDER_virtual/kernel ?= "linux-yocto"
KCONFIG_MODE ?= "alldefconfig"
LINUX_VERSION_EXTENSION ?= "-rockchip"

# xserver
PREFERRED_PROVIDER_virtual/xserver = "xserver-xorg"
XSERVER = " \
	xserver-xorg \
	xserver-xorg-utils \
	xserver-xorg-xvfb \
	xserver-xorg-extension-glx \
	xserver-xorg-module-libwfb \
	xserver-xorg-module-exa \
	xf86-video-modesetting \
	xf86-input-evdev \
	xf86-input-mouse \
	xf86-input-keyboard \
	"

# misc
IMAGE_FSTYPES += "ext4"

# boot device (sd-card/emmc)
RK_BOOT_DEVICE ??= "mmcblk0"
WICVARS_append = " RK_BOOT_DEVICE"
```

## conf/machine/rk3288-evb.conf
```bitbake
require conf/machine/include/rk3288.inc
require conf/machine/include/rockchip-wic.inc

KERNEL_IMAGETYPE = "uImage"
KERNEL_DEVICETREE = "rk3288-evb-rk808.dtb"

UBOOT_MACHINE = "evb-rk3288_defconfig"
```

## conf/machine/rock5b.conf
```bitbake
#@TYPE: Machine
#@NAME: Radxa Rock5b
#@DESCRIPTION: ROCK5 is the 5th generation of SBC designed by Radxa.
#https://wiki.radxa.com/Rock5

require conf/machine/include/rk3588.inc

MACHINEOVERRIDES =. "rock5b:"

KERNEL_DEVICETREE = "rockchip/rk3588-rock-5b.dtb"
MACHINE_EXTRA_RRECOMMENDS += "kernel-modules"

UBOOT_MACHINE = "rock5b-rk3588_defconfig"
```
